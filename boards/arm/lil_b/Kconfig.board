## boards/arm/lil_b/Kconfig.board
```kconfig
# Copyright (c) 2020 The ZMK Contributors
# SPDX-License-Identifier: MIT

config BOARD_LIL_B
	bool "lil-B"
	depends on SOC_NRF52840_QIAA
```

## boards/arm/lil_b/Kconfig.defconfig
```kconfig
# Copyright (c) 2020 The ZMK Contributors
# SPDX-License-Identifier: MIT

if BOARD_LIL_B

config ZMK_KEYBOARD_NAME
	default "lil-B"

if USB

config USB_NRFX
	default y

config USB_DEVICE_STACK
	default y

endif # USB

config BT_CTLR
	default BT

config ZMK_BLE
	default y

config ZMK_USB
	default y

config I2C
	default y

config MAX17048
	default y

endif # BOARD_LIL_B
```

## boards/arm/lil_b/lil_b_defconfig
```kconfig
# SPDX-License-Identifier: MIT

CONFIG_SOC_SERIES_NRF52X=y
CONFIG_SOC_NRF52840_QIAA=y
CONFIG_BOARD_LIL_B=y

# Enable deep sleep
CONFIG_ZMK_SLEEP=y

# Enable MPU
CONFIG_ARM_MPU=y

# Enable GPIO
CONFIG_GPIO=y

CONFIG_USE_DT_CODE_PARTITION=y
CONFIG_BUILD_OUTPUT_UF2=y

CONFIG_MPU_ALLOW_FLASH_WRITE=y
CONFIG_NVS=y
CONFIG_SETTINGS_NVS=y
CONFIG_FLASH=y
CONFIG_FLASH_PAGE_LAYOUT=y
CONFIG_FLASH_MAP=y

CONFIG_ZMK_USB=y
CONFIG_ZMK_BLE=y

# Enable I2C
CONFIG_I2C=y
CONFIG_I2C_NRFX=y

CONFIG_PINCTRL=y

# Windows Battery Reporting Fix
CONFIG_BT_GATT_ENFORCE_SUBSCRIPTION=n

# --- COMBO SETTINGS ---

# the number of combos that can be active at the same time. Default 4.
# CONFIG_ZMK_COMBO_MAX_PRESSED_COMBOS=8

# the maximum number of combos that can be active on a key position. Defaults to 5.
# (So you can have 5 separate combos that use position 3 for example)
CONFIG_ZMK_COMBO_MAX_COMBOS_PER_KEY=64

# the maximum number of keys that need to be pressed to activate a combo. Default 4. 
# If you want a combo that triggers when pressing 5 keys, you'd set this to 5 for example.
# CONFIG_ZMK_COMBO_MAX_KEYS_PER_COMBO=4

# Enable ZMK Studio (alpha)
# CONFIG_ZMK_STUDIO=y

# Turn on logging, and set ZMK logging to debug output
# CONFIG_LOG=y
# CONFIG_ZMK_USB_LOGGING=y
# CONFIG_LOG_PROCESS_THREAD_STARTUP_DELAY_MS=2500
# CONFIG_ZMK_LOG_LEVEL_DBG=y
# CONFIG_I2C_LOG_LEVEL_DBG=y
# CONFIG_SENSOR_LOG_LEVEL_DBG=y
```
